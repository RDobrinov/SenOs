## components/senos_sensors/sensor_drivers/BMx280/Kconfig
```kconfig
menu "BMX280 Sensor Configuration"
    menu "Temperature measurement"
        choice SENOS_BMX280_OVERSAMPLING_TEMPERATURE
            prompt "Default temperature oversampling"
            default SENOS_BMX280_OVERSAMPLING_Tx1
            help
                "Select defaul sensor resolution"
            config SENOS_BMX280_OVERSAMPLING_Tx1
                bool "Temperature oversampling x1"
            config SENOS_BMX280_OVERSAMPLING_Tx2
                bool "Temperature oversampling x2"
            config SENOS_BMX280_OVERSAMPLING_Tx4
                bool "Temperature oversampling x4"
            config SENOS_BMX280_OVERSAMPLING_Tx8
                bool "Temperature oversampling x8"
            config SENOS_BMX280_OVERSAMPLING_Tx16
                bool "Temperature oversampling x16"
        endchoice
        config SENOS_BMX280_OVERSAMPLING_TEMPERATURE
            int
            default 1 if SENOS_BMX280_OVERSAMPLING_Tx1
            default 2 if SENOS_BMX280_OVERSAMPLING_Tx2
            default 3 if SENOS_BMX280_OVERSAMPLING_Tx4
            default 4 if SENOS_BMX280_OVERSAMPLING_Tx8
            default 5 if SENOS_BMX280_OVERSAMPLING_Tx18

        config SENOS_BMX280_DECIMALS_T
        int "Temperature decimal places"
        range 0 4
        default 2
        help
            Default decimals for measured temperature
    endmenu
    menu "Pressure measurement"
        choice SENOS_BMX280_OVERSAMPLING_PRESSURE
            prompt "Default pressure oversampling"
            default SENOS_BMX280_OVERSAMPLING_Px1
            help
                "Select default pressure oversampling"
            config SENOS_BMX280_OVERSAMPLING_Px0
                bool "Pressure measurement disabled"
            config SENOS_BMX280_OVERSAMPLING_Px1
                bool "Pressure oversampling x1"
            config SENOS_BMX280_OVERSAMPLING_Px2
                bool "Pressure oversampling x2"
            config SENOS_BMX280_OVERSAMPLING_Px4
                bool "Pressure oversampling x4"
            config SENOS_BMX280_OVERSAMPLING_Px8
                bool "Pressure oversampling x8"
            config SENOS_BMX280_OVERSAMPLING_Px16
                bool "Pressure oversampling x16"
        endchoice
        config SENOS_BMX280_OVERSAMPLING_PRESSURE
            int
            default 0 if SENOS_BMX280_OVERSAMPLING_Px0
            default 1 if SENOS_BMX280_OVERSAMPLING_Px1
            default 2 if SENOS_BMX280_OVERSAMPLING_Px2
            default 3 if SENOS_BMX280_OVERSAMPLING_Px4
            default 4 if SENOS_BMX280_OVERSAMPLING_Px8
            default 5 if SENOS_BMX280_OVERSAMPLING_Px16

        config SENOS_BMX280_REPORT_HECTOPASCAL
            bool "Report pressure in hectopascal (hPa)"
            default n

        config SENOS_BMX280_DECIMALS_P
        int "Pressure decimal places"
        range 0 4
        default 2
        help
            Default decimals for measured pressure
    endmenu
    menu "Humidity measurement"
        choice SENOS_BMX280_OVERSAMPLING_HUMIDITY
            prompt "Default humidity oversampling"
            default SENOS_BMX280_OVERSAMPLING_Hx1
            help
                "Select default humidity oversampling"
            config SENOS_BMX280_OVERSAMPLING_Hx0
                bool "Humidity measurement disabled"
            config SENOS_BMX280_OVERSAMPLING_Hx1
                bool "Pressure oversampling x1"
            config SENOS_BMX280_OVERSAMPLING_Hx2
                bool "Pressure oversampling x2"
            config SENOS_BMX280_OVERSAMPLING_Hx4
                bool "Pressure oversampling x4"
            config SENOS_BMX280_OVERSAMPLING_Hx8
                bool "Pressure oversampling x8"
            config SENOS_BMX280_OVERSAMPLING_Hx16
                bool "Pressure oversampling x16"
        endchoice
        config SENOS_BMX280_OVERSAMPLING_HUMIDITY
            int
            default 0 if SENOS_BMX280_OVERSAMPLING_Hx0
            default 1 if SENOS_BMX280_OVERSAMPLING_Hx1
            default 2 if SENOS_BMX280_OVERSAMPLING_Hx2
            default 3 if SENOS_BMX280_OVERSAMPLING_Hx4
            default 4 if SENOS_BMX280_OVERSAMPLING_Hx8
            default 5 if SENOS_BMX280_OVERSAMPLING_Hx16
        
        config SENOS_BMX280_DECIMALS_H
        int "Humidity decimal places"
        range 0 4
        default 2
        help
            Default decimals for measured humidity
    endmenu
    
    config SENOS_BMX280_IIRFILTER
        bool "Activate hardware IIR Filter"
        help
            Enable or disable hardware IIR Filter
        default n
    choice SENOS_BMX280_IIR_COEFFICIENT
        prompt "Default IIR Filter coefficient"
        depends on SENOS_BMX280_IIRFILTER
        default SENOS_BMX280_IIR_COEFFICIENTx8
        config SENOS_BMX280_IIR_COEFFICIENTx2
            bool "Filter coefficient 2"
        config SENOS_BMX280_IIR_COEFFICIENTx4
            bool "Filter coefficient 4"
        config SENOS_BMX280_IIR_COEFFICIENTx8
            bool "Filter coefficient 8"
        config SENOS_BMX280_IIR_COEFFICIENTx16
            bool "Filter coefficient 16"
    endchoice
    config SENOS_BMX280_IIR_COEFFICIENT
        int
        default 1 if SENOS_BMX280_IIR_COEFFICIENTx2
        default 2 if SENOS_BMX280_IIR_COEFFICIENTx4
        default 3 if SENOS_BMX280_IIR_COEFFICIENTx8
        default 4 if SENOS_BMX280_IIR_COEFFICIENTx16
endmenu
```

## components/senos_sensors/sensor_drivers/DS18x20/Kconfig
```kconfig
menu "DS18x20 Sensor Configuration"
    choice SENOS_DS18X20_RESOLUTION
        prompt "DS18X20 Default Resolution"
        default SENOS_DS18X20_RESOLUTION_12
        help
            "Select defaul sensor resolution"
        config SENOS_DS18X20_RESOLUTION_9
            bool "9 bit resolution ( 0.5°C )"
        config SENOS_DS18X20_RESOLUTION_10
            bool "9 bit resolution ( 0.25°C )"
        config SENOS_DS18X20_RESOLUTION_11
            bool "9 bit resolution ( 0.125°C )"
        config SENOS_DS18X20_RESOLUTION_12
            bool "9 bit resolution ( 0.0625°C )"
    endchoice
    config SENOS_DS18X20_RESOLUTION
        int
        default 0 if SENOS_DS18X20_RESOLUTION_9
        default 1 if SENOS_DS18X20_RESOLUTION_10
        default 2 if SENOS_DS18X20_RESOLUTION_11
        default 3 if SENOS_DS18X20_RESOLUTION_12

    config SENOS_DS18X20_DECIMALS
    int "Default decimal places"
    range 0 4
    default 2
    help
        Default decimals for measured temperature
    
    config SENOS_DS18X20_IIRFILTER
        bool "Activate internal IIR Filter"
        help
            Enable or disable internal driver IIR Filter
        default n
    
endmenu
```

## components/senos_sensors/sensor_drivers/MAX31865/Kconfig
```kconfig
menu "MAX31865 Configuration"
    choice SENOS_MAX31865_FILTER
        prompt "Default notch filter frequency"
        default SENOS_MAX31865_FILTER_50HZ
        help
            "Select the notch frequency for the noise rejection filter"
        config SENOS_MAX31865_FILTER_50HZ
            bool "50Hz filter"
        config SENOS_MAX31865_FILTER_60HZ
            bool "60Hz filter"
    endchoice
    config SENOS_MAX31865_FILTER
        int
        default 1 if SENOS_MAX31865_FILTER_50HZ
        default 0 if SENOS_MAX31865_FILTER_60HZ

    choice SENOS_MAX31865_WIRES
        prompt "RTD Wire connection"
        default SENOS_MAX31865_WIRES_4W
        help
            "Select the notch frequency for the noise rejection filter"
        config SENOS_MAX31865_WIRES_2W
            bool "2 wires connection"
        config SENOS_MAX31865_WIRES_3W
            bool "3 wires connection"
        config SENOS_MAX31865_WIRES_4W
            bool "4 wires connection"
    endchoice
    config SENOS_MAX31865_WIRES
        int
        default 0 if SENOS_MAX31865_WIRES_2W
        default 1 if SENOS_MAX31865_WIRES_3W
        default 0 if SENOS_MAX31865_WIRES_4W

    config SENOS_MAX31865_RREF
    int "Resistance of the reference resistor"
    range 390 450
    default 430
    help
        Resistance of the low drift reference resistor in Ohms

    config SENOS_MAX31865_DECIMALS
    int "Default decimal places"
    range 0 4
    default 2
    help
        Default decimals for measured temperature

    config SENOS_MAX31865_IIRFILTER
        bool "Activate internal IIR Filter"
        help
            Enable or disable internal driver IIR Filter
        default n
endmenu
```
